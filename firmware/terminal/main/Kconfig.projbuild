## firmware/terminal/main/Kconfig.projbuild
```kconfig
menu "Terminal - siec"

    config TERMINAL_WIFI_SSID
        string "SSID sieci Wi-Fi"
        default ""
        help
            Nazwa sieci, do ktorej laczy sie terminal.

    config TERMINAL_WIFI_PASSWORD
        string "Haslo sieci Wi-Fi"
        default ""
        help
            Haslo sieci. Trafia do sdkconfig, ktory jest poza repo.
    config TERMINAL_MQTT_URI
        string "Adres brokera MQTT"
        default "mqtt://192.168.0.10:1883"
        help
            Adres brokera, np. mqtt://172.20.10.2:1883 (w sieci test. komputer PC).
endmenu

menu "Terminal - testy"

config TERMINAL_TEST_EVENTS
    int "Testowe zdarzenia, przy pustym dzienniku (0 = wylaczone)"
    default 0
    range 0 5000
    help
        TYLKO do testow synchronizacji. Przy starcie z pustym dziennikiem
        zapisuje N zdarzen uzytkownika testowego ID: 999 (START/STOP na przemian).

endmenu
```
